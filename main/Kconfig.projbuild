## main/Kconfig.projbuild
```kconfig
menu "Snap Air Unit"

    menu "WiFi Configuration"

        config ESP_WIFI_AP_SSID
            string "WiFi AP SSID"
            default "SnapAirUnit"
            help
                SSID (network name) for the example to connect to.
    
        config ESP_WIFI_AP_PASSWORD
            string "WiFi AP Password"
            default "12345678"
            help
                WiFi password (WPA or WPA2) for the example to use.

        config ESP_WIFI_AP_IP_SEGMENT
            int "WiFi AP IP segment"
            range 1 253
            default 10
            help
                WiFi AP IP segment

        config ESP_WIFI_STA_SSID
            string "WiFi Station SSID"
            default "AutoLab"
            help
                SSID (network name) for the example to connect to.
    
        config ESP_WIFI_STA_PASSWORD
            string "WiFi Station Password"
            default "68686868"
            help
                WiFi password (WPA or WPA2) for the example to use.

        config ESP_WIFI_CHANNEL
            int "WiFi Channel"
            range 1 13
            default 1
            help
                WiFi channel (network channel) for the example to use.
    
        config ESP_MAX_STA_CONN
            int "Maximal STA connections"
            default 4
            help
                Max number of the STA connects to AP.
    
        config ESP_MAXIMUM_RETRY
            int "Maximum retry"
            default 5
            help
                Set the Maximum retry to avoid station reconnecting to the AP unlimited when the AP is really inexistent.

        config ESP_MAXIMUM_RETRY_TIMES
            int "Maximum retry time in seconds"
            default 10
            help
                Set the Maximum retry time to avoid station reconnecting to the AP unlimited when the AP is really inexistent.

        choice ESP_WIFI_SCAN_AUTH_MODE_THRESHOLD
            prompt "WiFi Scan auth mode threshold"
            default ESP_WIFI_AUTH_WPA_WPA2_PSK
            help
                The weakest authmode to accept in the scan mode.
                This value defaults to ESP_WIFI_AUTH_WPA_WPA2_PSK incase password is present and ESP_WIFI_AUTH_OPEN is used.
                Please select ESP_WIFI_AUTH_WEP/ESP_WIFI_AUTH_WPA_PSK incase AP is operating in WEP/WPA mode.
    
            config ESP_WIFI_AUTH_OPEN
                bool "OPEN"
            config ESP_WIFI_AUTH_WEP
                bool "WEP"
            config ESP_WIFI_AUTH_WPA_PSK
                bool "WPA PSK"
            config ESP_WIFI_AUTH_WPA2_PSK
                bool "WPA2 PSK"
            config ESP_WIFI_AUTH_WPA_WPA2_PSK
                bool "WPA/WPA2 PSK"
            config ESP_WIFI_AUTH_WPA3_PSK
                bool "WPA3 PSK"
            config ESP_WIFI_AUTH_WPA2_WPA3_PSK
                bool "WPA2/WPA3 PSK"
            config ESP_WIFI_AUTH_WAPI_PSK
                bool "WAPI PSK"
        endchoice

    endmenu

    menu "Restful Configuration"
    
        config RESTFUL_MDNS_HOST_NAME
            string "mDNS Host Name"
            default "Snap-Air-Unit"
            help
                Specify the domain name used in the mDNS service.
                Note that webpage also take it as a part of URL where it will send GET/POST requests to.
    
        choice RESTFUL_WEB_DEPLOY_MODE
            prompt "Website deploy mode"
            default RESTFUL_WEB_DEPLOY_SF
            help
                Select website deploy mode.
                You can deploy website to host, and ESP32 will retrieve them in a semihost way (JTAG is needed).
                You can deploy website to SD card or SPI flash, and ESP32 will retrieve them via SDIO/SPI interface.
                Detailed operation steps are listed in the example README file.
            config RESTFUL_WEB_DEPLOY_SEMIHOST
                bool "Deploy website to host (JTAG is needed)"
                help
                    Deploy website to host.
                    It is recommended to choose this mode during developing.
            config RESTFUL_WEB_DEPLOY_SD
                depends on IDF_TARGET_ESP32
                bool "Deploy website to SD card"
                help
                    Deploy website to SD card.
                    Choose this production mode if the size of website is too large (bigger than 2MB).
            config RESTFUL_WEB_DEPLOY_SF
                bool "Deploy website to SPI Nor Flash"
                help
                    Deploy website to SPI Nor Flash.
                    Choose this production mode if the size of website is small (less than 2MB).
        endchoice
    
        if RESTFUL_WEB_DEPLOY_SEMIHOST
            config EXAMPLE_HOST_PATH_TO_MOUNT
                string "Host path to mount (e.g. absolute path to web dist directory)"
                default "PATH-TO-WEB-DIST_DIR"
                help
                    When using semihost in ESP32, you should specify the host path which will be mounted to VFS.
                    Note that only absolute path is acceptable.
        endif

    endmenu

    menu "Storage Configuration"
	
        config RESTFUL_WEB_MOUNT_POINT
            string "Website mount point in VFS"
            default "/www"
            help
                Specify the mount point in VFS.

        config SPIFFS_MOUNT_POINT
            string "Spiffs mount point in VFS"
            default "/storage"
            help
                Specify the mount point in VFS.

	endmenu

    menu "UDP Configuration"
    
        choice EXAMPLE_IP_MODE
            prompt "IP Version"
            default EXAMPLE_IPV4
            help
                UDP server & client can use either IPV4 or IPV6.
    
            config EXAMPLE_IPV4
                bool "IPV4"
    
            config EXAMPLE_IPV6
                bool "IPV6"
                select EXAMPLE_CONNECT_IPV6
    
        endchoice



        menu "UDP Control Server Configuration"
	    
            config CONTROL_SERVER_PORT
                int "Port"
                range 0 65535
                default 8889
                help
                    Local port the UDP server will listen on.
        
        endmenu
		
		
        menu "UDP Status Server Configuration"
		    
            config STATUS_SERVER_PORT
                int "Port"
                range 0 65535
                default 8890
                help
                    The remote port to which the client will send data.
	
		endmenu
    
    endmenu

    menu "MSP UART Configuration"

        config MSP_TTL_TXD
            int "TTL_TXD pin"
            range ENV_GPIO_RANGE_MIN ENV_GPIO_IN_RANGE_MAX
            default 4
            help
                GPIO pin number to be used as MSP_TTL_TXD.
	    
        config MSP_TTL_RXD
            int "TTL_RXD pin"
            range ENV_GPIO_RANGE_MIN ENV_GPIO_IN_RANGE_MAX
            default 5
            help
                GPIO pin number to be used as MSP_TTL_RXD.

        config DJI_TTL_TXD
            int "DJI_TTL_TXD pin"
            range ENV_GPIO_RANGE_MIN ENV_GPIO_IN_RANGE_MAX
            default 17
            help
                GPIO pin number to be used as DJI_TTL_TXD.
	    
        config DJI_TTL_RXD
            int "DJI_TTL_RXD pin"
            range ENV_GPIO_RANGE_MIN ENV_GPIO_IN_RANGE_MAX
            default 16
            help
                GPIO pin number to be used as DJI_TTL_RXD.

    endmenu

    menu "LED Configuration"
    
        orsource "components/env_caps/$IDF_TARGET/Kconfig.env_caps"
    
        choice BLINK_LED
            prompt "Blink LED type"
            default BLINK_LED_GPIO if IDF_TARGET_ESP32 || IDF_TARGET_ESP32C2
            default BLINK_LED_RMT
            help
                Defines the default peripheral for blink example
    
            config BLINK_LED_GPIO
                bool "GPIO"
            config BLINK_LED_RMT
                bool "RMT - Addressable LED"
        endchoice
    
        config BLINK_MODE_GPIO
            int "Blink GPIO number"
            range ENV_GPIO_RANGE_MIN ENV_GPIO_OUT_RANGE_MAX
            default 18
            help
                GPIO number (IOxx) to blink on and off or the RMT signal for the addressable LED.
                Some GPIOs are used for other purposes (flash connections, etc.) and cannot be used to blink.

        config BLINK_STATUS_GPIO
            int "Blink GPIO number"
            range ENV_GPIO_RANGE_MIN ENV_GPIO_OUT_RANGE_MAX
            default 19
            help
                GPIO number (IOxx) to blink on and off or the RMT signal for the addressable LED.
                Some GPIOs are used for other purposes (flash connections, etc.) and cannot be used to blink.

        config BLINK_PERIOD_SLOW
            int "Blink period for slow mode in ms"
            range 10 3600000
            default 1000
            help
                Define the blinking period for slow mode in milliseconds.


        config BLINK_PERIOD_FAST
            int "Blink period for fast mode in ms"
            range 10 3600000
            default 300
            help
                Define the blinking period for fast mode in milliseconds.

        config BLINK_INTERVAL
            int "Blink period in ms"
            range 10 3600000
            default 1000
            help
                Define the blinking period in milliseconds.

        config BLINK_SUCCESSIVE_ERROR
            int "Successive blink times for error"
            range 2 5
            default 3
            help
                Define successive blinking times for error.
				
        config BLINK_SUCCESSIVE_WARNING
            int "Successive blink times for warning"
            range 2 5
            default 2
            help
                Define successive blinking times for warning.

    endmenu


    menu "Key Configuration"

        orsource "$IDF_PATH/examples/common_components/env_caps/$IDF_TARGET/Kconfig.env_caps"
	    
        config KEY_MODE
            int "KEY_MODE input pin"
            range ENV_GPIO_RANGE_MIN ENV_GPIO_IN_RANGE_MAX
            default 0
            help
                GPIO pin number to be used as KEY_MODE.
	    
        config KEY_ACTIVE
            int "KEY_ACTIVE level"
            range 0 1
            default 0
            help
                GPIO level to be used as active key.

        config KEY_PRESS_RESERVE
            int "KEY multi successive press in seconds"
            range 3 30
            default 3
            help
                GPIO level hold for a short period of time (in ms).

        config KEY_LONG_PRESS
            int "KEY_action of long press in seconds"
            range 1 30
            default 10
            help
                GPIO level hold to be active for a long period of time (in seconds).

    endmenu

    menu "SPIFFS menu"
    
        config EXAMPLE_SPIFFS_CHECK_ON_START
            bool "Run SPIFFS_check on every start-up"
            default y
            help
                If this config item is set, esp_spiffs_check() will be run on every start-up.
                Slow on large flash sizes.
    endmenu
	
    menu "Command History"
    
        config STORE_HISTORY
            bool "Store command history in flash"
            default y
            help
                Linenoise line editing library provides functions to save and load
                command history. If this option is enabled, initalizes a FAT filesystem
                and uses it to store command history.
    
    endmenu
endmenu
```

## sdkconfig.defaults
```kconfig
# Override some defaults so BT stack is enabled and WiFi disabled by default
CONFIG_BT_ENABLED=y
CONFIG_BTDM_CTRL_MODE_BLE_ONLY=n
CONFIG_BTDM_CTRL_MODE_BR_EDR_ONLY=y
CONFIG_BTDM_CTRL_MODE_BTDM=n
CONFIG_BT_CLASSIC_ENABLED=y
CONFIG_WIFI_ENABLED=y
CONFIG_BT_SPP_ENABLED=y
CONFIG_BT_BLE_ENABLED=n

CONFIG_HTTPD_MAX_REQ_HDR_LEN=1024
CONFIG_SPIFFS_OBJ_NAME_LEN=64
CONFIG_FATFS_LONG_FILENAME=y
CONFIG_FATFS_LFN_HEAP=y
#
# Partition Table
#
CONFIG_ESPTOOLPY_FLASHSIZE_4MB=y
CONFIG_PARTITION_TABLE_CUSTOM=y
CONFIG_PARTITION_TABLE_CUSTOM_FILENAME="partitions.csv"
CONFIG_PARTITION_TABLE_FILENAME="partitions.csv"
CONFIG_PARTITION_TABLE_OFFSET=0x8000
CONFIG_PARTITION_TABLE_MD5=y

# Reduce bootloader log verbosity
#CONFIG_BOOTLOADER_LOG_LEVEL_WARN=y
#CONFIG_BOOTLOADER_LOG_LEVEL=2

# Enable FreeRTOS stats formatting functions, needed for 'tasks' command
CONFIG_FREERTOS_USE_TRACE_FACILITY=y
CONFIG_FREERTOS_USE_STATS_FORMATTING_FUNCTIONS=y
```
